## config/boards/shields/cck_ball/Kconfig.defconfig
```kconfig
if SHIELD_CCK_BALL_LEFT || SHIELD_CCK_BALL_RIGHT

config ZMK_KEYBOARD_NAME
    default "cck_ball"

config ZMK_SPLIT
    default y

endif
```
